#ifndef BG0806_C
#define  BG0806_C


#include "asm/iic.h"
#include "asm/isp_dev.h"
#include "gpio.h"
#include "bg0806.h"
#include "asm/isp_alg.h"



#define ROWTIME  0x898
#define VBLANK   0x25

#define INPUT_CLK  24

#define PCLK  24

#define TEXP_DEFAULT 0x32
#define EXP_MCLK      0x0

//PCLK   ((INPUT_CLK) * (PLM+2)/((PLN+2)*(2+pclkdiv)))
//Tfrm = ROWTIME*(8+BG0806_OUTPUT_H+VBLANK)/PCLK;
//Texp = (TEXP ∗ ROWTIME + TEXP_MCK) /PCLK


static u32 reset_gpio[2] = {-1, -1};

static u32 gRowTime = ROWTIME;
static u8 cur_sensor_type = 0xff;
static u32 frame_rate = 30;

static u8 vrefh_min_tlb = 0x0e;
static u8 pre_index = 0;

static  u8 reg_0x2b;
static 	u8 reg_0x30;
static 	u8 reg_0x34;
static 	u8 reg_0x4d;
static 	u8 reg_0x4f;
static 	u8 reg_0x61;
static 	u8 reg_0x67;
static 	u8 reg_0x68;
static 	u8 reg_0x9e;

extern void *bg0806_get_ae_params();
extern void *bg0806_get_awb_params();
extern void *bg0806_get_iq_params();
extern void bg0806_ae_ev_init(u32 fps);

typedef struct {
    u16 addr;
    u8 value;
} Sensor_reg_ini;

struct stVrefh {
    u16 index;
    u16 th_low;
    u16 th_high;
    u8 vrefh;
};

struct stVrefh stVrefhTable[] = {
    {5, 263, 267, 0x22},
    {4, 216, 220, 0x1c},
    {3, 176, 180, 0x17},
    {2, 130, 134, 0x12},
    {1, 113, 117, 0x10}
};

#define EXTERNAL_LDO_1V5 1

//如果系统VDDIO使用3.3V请定义此宏定义值为1
//如果系统VDDIO使用1.8V请定义此宏定义值为0
#define	VDDIO_VOLTAGE_3V3 1
#define DSC_ADDR_BASE 0x0400

static Sensor_reg_ini BG0806_INI_REG[] = {
    0x0200, 0x01,
    0x0003, 0x27,
    0x00fa, 0x8f,
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    0x0042, 0x01,

#if VDDIO_VOLTAGE_3V3
    0x005c, 0x07, //lsh_io ctrlbit for 3.3VDDIO
#else
    0x005c, 0x00, //lsh_io ctrlbit for 1.8VDDIO
#endif

    0x0061, 0x04,
    0x0062, 0x50, //rmp2_w@pclk domain
    0x0065, 0x80, //rmp1_w@rmpclk domain
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    0x01a5, 0x07, //row noise on 07
#ifdef EXTERNAL_LDO_1V5
    0x0132, 0x00, //k
    0x0133, 0xff,
    0x0206, 0x03,
    0x0207, 0x01,
    0x006e, 0x00,
#else
    0x0132, 0x01, //k
    0x0133, 0x30,
    0x0206, 0x03,
    0x0207, 0xb7,
    0x006e, 0x01,
#endif

    0x008d, 0xFF,
    0x0088, 0x05, //the phase of pclk

    0x001d, 0x01

};



const u8 Tab_sensor_dsc[768] = {
#ifdef	EXTERNAL_LDO_1V5
    0x08,
    0xf1,
    0x07,
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    0x07,
    0x74
#else
    0x0f,
    0xff,
    0x0f,
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    0x06,
    0x55
#endif
};


static void *iic = NULL;

unsigned char wrBG0806Reg(unsigned short regID, unsigned char regDat)
{
    u8 ret = 1;
    u8 high, low;

    high = regID >> 8;
    low = regID & 0xff;

    dev_ioctl(iic, IIC_IOCTL_START, 0);
    if (dev_ioctl(iic, IIC_IOCTL_TX_WITH_START_BIT, 0x64)) {
        ret = 0;
        goto __wend;
    }
    if (dev_ioctl(iic, IIC_IOCTL_TX, high)) {
        ret = 0;
        goto __wend;
    }

    if (dev_ioctl(iic, IIC_IOCTL_TX, low)) {
        ret = 0;
        goto __wend;
    }
    if (dev_ioctl(iic, IIC_IOCTL_TX_WITH_STOP_BIT, regDat)) {
        ret = 0;
        goto __wend;
    }

__wend:

    dev_ioctl(iic, IIC_IOCTL_STOP, 0);
    return ret;
}

unsigned char rdBG0806Reg(unsigned short regID, unsigned char *regDat)
{
    u8 ret = 1;
    u8 high, low;

    high = regID >> 8;
    low = regID & 0xff;

    dev_ioctl(iic, IIC_IOCTL_START, 0);
    if (dev_ioctl(iic, IIC_IOCTL_TX_WITH_START_BIT, 0x64)) {
        ret = 0;
        goto __rend;
    }

    delay(10);

    if (dev_ioctl(iic, IIC_IOCTL_TX, high)) {
        ret = 0;
        goto __rend;
    }

    delay(10);

    if (dev_ioctl(iic, IIC_IOCTL_TX_WITH_STOP_BIT, low)) {
        ret = 0;
        goto __rend;
    }

    delay(10);

    if (dev_ioctl(iic, IIC_IOCTL_TX_WITH_START_BIT, 0x65)) {
        ret = 0;
        goto __rend;
    }

    delay(10);

    if (dev_ioctl(iic, IIC_IOCTL_RX_WITH_STOP_BIT, (u32)regDat)) {
        ret = 0;
        goto __rend;
    }
__rend:

    dev_ioctl(iic, IIC_IOCTL_STOP, 0);
    return ret;

}


/*************************************************************************************************
 sensor api
 *************************************************************************************************/

void BG0806_config_SENSOR(u16 *width, u16 *height, u8 *format, u8 *frame_freq)
{
    u32 i;
    u16 dsc_addr;


    BG0806_set_output_size(width, height, frame_freq);

    for (i = 0; i < sizeof(BG0806_INI_REG) / sizeof(Sensor_reg_ini); i++) {
        wrBG0806Reg(BG0806_INI_REG[i].addr, BG0806_INI_REG[i].value);
    }

    dsc_addr = DSC_ADDR_BASE;

    for (i = 0; i < 768; i++) {
        wrBG0806Reg(dsc_addr + i, Tab_sensor_dsc[i]);
    }

    *format = SEN_IN_FORMAT_RGGB;

    gRowTime = ROWTIME;

    bg0806_ae_ev_init(*frame_freq);

    return;
}

s32 BG0806_set_output_size(u16 *width, u16 *height, u8 *frame_freq)
{
    *width = BG0806_OUTPUT_W;
    *height = BG0806_OUTPUT_H;

    return 0;
}

s32 BG0806_power_ctl(u8 isp_dev, u8 is_work)
{
    return 0;
}

void BG0806_xclk_set(u8 isp_dev)
{

}

s32 BG0806_ID_check(void)
{
    u8 pid = 0x00;
    u8 ver = 0x00;
    u8 i;

    for (i = 0; i < 3; i++) {
        rdBG0806Reg(0x0000, &pid);
        rdBG0806Reg(0x0001, &ver);
    }

    puts("Sensor ID \n");
    put_u8hex(pid);
    put_u8hex(ver);
    puts("\n");

    if (pid != 0x08 || ver != 0x06) {
        puts("\n----not BG0806-----\n");
        return -1;
    }
    puts("\n----hello BG0806-----\n");
    return 0;
}

void BG0806_reset(u8 isp_dev)
{
    puts("BG0806 reset \n");

    u32 gpio;

    if (isp_dev == ISP_DEV_0) {
        gpio = reset_gpio[0];
    } else {
        gpio = reset_gpio[1];
    }

    printf("gpio=%d\n", gpio);

    gpio_direction_output(gpio, 0);
    delay(40000);
    gpio_direction_output(gpio, 1);
    delay(40000);

}


s32 BG0806_check(u8 isp_dev, u32 _reset_gpio, u32 pwdn_gpio)
{
    if (isp_dev == ISP_DEV_1) {
        return -1;
    }
    printf("\n\n BG0806_check reset pin :%d\n\n", _reset_gpio);
    if (!iic) {
        if (isp_dev == ISP_DEV_0) {
            iic = dev_open("iic0", 0);
        } else {
            iic = dev_open("iic1", 0);
        }
        if (!iic) {
            return -1;
        }
    } else {
        if (cur_sensor_type != isp_dev) {
            return -1;
        }
    }
    printf("\n\n isp_dev =%d\n\n", isp_dev);

    reset_gpio[isp_dev] = _reset_gpio;

    BG0806_reset(isp_dev);

    if (0 != BG0806_ID_check()) {
        dev_close(iic);
        iic = NULL;
        return -1;
    }

    cur_sensor_type = isp_dev;


    return 0;
}


s32 BG0806_init(u8 isp_dev, u16 *width, u16 *height, u8 *format, u8 *frame_freq)
{
    puts("\n\n BG0806_init \n\n");

    BG0806_config_SENSOR(width, height, format, frame_freq);
    return 0;
}



static void set_again(u32 again)
{
    wrBG0806Reg(0x00b1, again);
    return;
}

static void set_dgain(u32 dgain)
{

    wrBG0806Reg(0x00bc, dgain >> 8);
    wrBG0806Reg(0x00bd, dgain & 0xff);
}

static void cal_texp_mck(u32 exp_time, u32 row_time, u32 inputClk, u32 *texp, u32 *mck)
{
    *texp = exp_time * inputClk / row_time;
    u32 tmp2 = (*texp) * row_time;
    if (tmp2 < exp_time * inputClk) {
        *mck = (exp_time * inputClk - tmp2);
    } else {
        *mck = 0;
    }

    return;
}

//q10
static void calc_gain(u32 gain, u32 *_again, u32 *_dgain)
{
#if 0
    u32 ag;
    u32 vref = (128 << 10) / gain - 1;
    if (vref < 0x0c) {
        vref = 0x0c;
    }

    ag = (128 << 10) / (vref + 1);

    *_again = vref;
    *_dgain = gain * 0x200 / ag;
    //printf("_again=%d, _dgain=%d\n", *_again, *_dgain);
#else

    u32 total_gain;
    u8 vrefh, temp;
    u16 dgain;

    u32 dark_ave;

    u16 vrefh_old;
    u16 rmp_gain;
    u8 i, rdRegDat;

    rdBG0806Reg(0x00B1, &rdRegDat) ;
    vrefh_old = rdRegDat ;
    rmp_gain = 127 / vrefh_old;

    dark_ave = 0 ;
    rdBG0806Reg(0x012B, &rdRegDat) ;
    dark_ave = rdRegDat ;
    dark_ave <<= 8 ;
    rdBG0806Reg(0x012C, &rdRegDat) ;
    dark_ave |= rdRegDat ;

    if (dark_ave > 0xfff) {
        dark_ave = 0;
    }

    dark_ave = dark_ave / rmp_gain;
    vrefh_min_tlb = 0x0e;

#if 1
    if (dark_ave < stVrefhTable[4].th_low) {
        pre_index = 0;
        vrefh_min_tlb = 0x0e;
    } else {
        i = 0;
        while (i < 5) {
            if (pre_index < stVrefhTable[i].index && dark_ave > stVrefhTable[i].th_high) {
                pre_index = stVrefhTable[i].index;
                vrefh_min_tlb = stVrefhTable[i].vrefh;
                break;
            }
            i++;
        }

        for (i = 0; i < 5; i++) {
            if (pre_index >=  stVrefhTable[i].index && dark_ave < stVrefhTable[i].th_low) {
                pre_index = stVrefhTable[i - 1].index;
                vrefh_min_tlb = stVrefhTable[i - 1].vrefh;
            }
        }
    }
#endif

    total_gain = gain >> 4;
    vrefh = (127 << 6) / total_gain;
    temp = (127 << 6) % total_gain ;
    if (temp >= 5) {
        vrefh = vrefh + 1 ;
    }

    if (vrefh > 0x7f) {
        vrefh = 0x7f ;
    } else if (vrefh < vrefh_min_tlb) {
        vrefh = vrefh_min_tlb ;
    }

    if ((vrefh > vrefh_min_tlb) && (vrefh <= 0x7f)) {
        //先用again，dgain=1x;
        dgain = 0x200;  //min 1x

#if 0
        //25fps
        reg_0x2b = 0x80;
        reg_0x30 = 0x00;
        reg_0x34 = 0x00;
        reg_0x4d = 0x00;
        reg_0x4f = 0x09;
        reg_0x61 = 0x05;
        reg_0x67 = 0x01;
        reg_0x68 = 0x90;
#else
        //30fps
        reg_0x2b = 0x30;
        reg_0x30 = 0x00;
        reg_0x34 = 0x00;
        reg_0x4d = 0x00;
        reg_0x4f = 0x09;
        reg_0x61 = 0x04;
        reg_0x67 = 0x01;
        reg_0x68 = 0x90;
#endif
    } else if (vrefh == vrefh_min_tlb) {
        //当again达到最大时,用dgain

        dgain = (total_gain * vrefh * (1 << 3)) / 127; //dgain

        reg_0x2b = 0x10;
        reg_0x30 = 0x01;
        reg_0x34 = 0x01;
        reg_0x4d = 0x03;
        reg_0x4f = 0x0c;
        reg_0x61 = 0x02;
        reg_0x67 = 0x00;
        reg_0x68 = 0x80;
    }



    *_again = vrefh ;
    *_dgain = dgain ;

    //printf("_again=%d, _dgain=%d\n", *_again, *_dgain);
#endif
}

static void set_shutter(u32 texp, u32 texp_mck)
{
    wrBG0806Reg(0x000c, texp >> 8);
    wrBG0806Reg(0x000d, texp & 0xff); //
    wrBG0806Reg(0x0026, texp_mck >> 8);
    wrBG0806Reg(0x0027, texp_mck & 0xff);
}


u32 bg0806_calc_shutter(isp_ae_shutter_t *shutter, u32 exp_time_us, u32 gain)
{
    u32 texp;
    u32 mck;

    cal_texp_mck(exp_time_us, gRowTime, PCLK, &texp, &mck);

    shutter->ae_exp_line =  texp;
    shutter->ae_gain = gain;
    shutter->ae_exp_clk = mck;
    return 0;

}



u32 bg0806_set_shutter(isp_ae_shutter_t *shutter)
{
    u32 again, dgain;
    calc_gain(shutter->ae_gain, &again, &dgain);
    set_again(again);
    set_dgain(dgain);

    set_shutter(shutter->ae_exp_line, shutter->ae_exp_clk);

    wrBG0806Reg(0x0030, reg_0x30);
    wrBG0806Reg(0x0034, reg_0x34);
    wrBG0806Reg(0x004d, reg_0x4d);
    wrBG0806Reg(0x0061, reg_0x61);

    wrBG0806Reg(0x002b, reg_0x2b);
    wrBG0806Reg(0x004f, reg_0x4f);
    wrBG0806Reg(0x0067, reg_0x67);
    wrBG0806Reg(0x0068, reg_0x68);

#if 0
    wrBG0806Reg(0x007e, 0x07) ;//25fps
#else
    wrBG0806Reg(0x007e, 0x06) ;//30fsp
#endif

    //wrBG0806Reg(0x00B1, vrefh);
    //wrBG0806Reg(0x00BC, 0xFF&(dgain>>8));
    //wrBG0806Reg(0x00BD, 0xFF&(dgain>>0));
    wrBG0806Reg(0x014a, 0x01);
    //wrBG0806Reg(0x001D, 0x02);


    wrBG0806Reg(0x001d, 0x02);
    return 0;
}


void BG0806_sleep()
{

}

void BG0806_wakeup()
{

}

void BG0806_W_Reg(u16 addr, u16 val)
{
    wrBG0806Reg((u16) addr, (u8) val);
}

u16 BG0806_R_Reg(u16 addr)
{
    u8 val;
    rdBG0806Reg((u16) addr, &val);
    return val;
}



REGISTER_CAMERA(BG0806) = {
    .logo 				= 	"BG0806",
    .isp_dev 			= 	ISP_DEV_NONE,
    .in_format 			= 	SEN_IN_FORMAT_RGGB,
    .out_format 		= 	ISP_OUT_FORMAT_YUV,
    .mbus_type          =   SEN_MBUS_PARALLEL,
    .mbus_config        =   SEN_MBUS_DATA_WIDTH_8B | SEN_MBUS_VSYNC_ACTIVE_LOW,
    .fps         		= 	30,

    .sen_size 			= 	{BG0806_OUTPUT_W, BG0806_OUTPUT_H},
    .isp_size 			= 	{BG0806_OUTPUT_W, BG0806_OUTPUT_H},

    .cap_fps         		= 	30,
    .sen_cap_size 			= 	{BG0806_OUTPUT_W, BG0806_OUTPUT_H},
    .isp_cap_size 			= 	{BG0806_OUTPUT_W, BG0806_OUTPUT_H},

    .ops                =   {
        .avin_fps           =   NULL,
        .avin_valid_signal  =   NULL,
        .avin_mode_det      =   NULL,
        .sensor_check 		= 	BG0806_check,
        .init 		        = 	BG0806_init,
        .set_size_fps 		=	BG0806_set_output_size,
        .power_ctrl         =   BG0806_power_ctl,

        .get_ae_params 	    =	bg0806_get_ae_params,
        .get_awb_params 	=	bg0806_get_awb_params,
        .get_iq_params 	    =	bg0806_get_iq_params,

        .sleep 		        =	BG0806_sleep,
        .wakeup 		    =	BG0806_wakeup,
        .write_reg 		    =	BG0806_W_Reg,
        .read_reg 		    =	BG0806_R_Reg,

    }
};


#endif

