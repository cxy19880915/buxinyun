#ifndef BG0806_MIPI_C
#define  BG0806_MIPI_C


#include "asm/iic.h"
#include "asm/isp_dev.h"
#include "gpio.h"
#include "bg0806_mipi.h"
#include "asm/isp_alg.h"

#define ROWTIME         0x8ae
#define VBLANK_30FPS    0x27 // 0x25
#define VBLANK_25FPS    0xfe
#define VBLANK_20FPS    0x250
#define VBLANK_16FPS    0x3f5

#define MAX_EXP_LINE_30FPS  1131
#define MAX_EXP_LINE_25FPS  1348
#define MAX_EXP_LINE_20FPS  1685
#define MAX_EXP_LINE_16FPS  2107

#define INPUT_CLK       24

#define PCLK            75000

#define ROW_TIME_NS     29630


//PCLK   ((INPUT_CLK) * (PLM+2)/((PLN+2)*(2+pclkdiv)))
//Tfrm = ROWTIME*(8+BG0806_MIPI_OUTPUT_H+VBLANK)/PCLK;
//Texp = (TEXP * ROWTIME + TEXP_MCK) /PCLK

//dsc_k blcc_k different with chip pid
#define BG0806A		0x01
#define BG0806C1	0x07
#define BG0806C2	0x0b
#define BG0806B1	0x03
#define BG0806B2	0x0f


static u32 frame_rate = 30; // 30;
static u32 reset_gpios[2] = {-1, -1};
static u32 pwdn_gpios[2] = {-1, -1};

static u32 gRowTime = ROWTIME;
static u32 gVblank = VBLANK_25FPS;// VBLANK_30FPS;
static u32 gExplineMax = MAX_EXP_LINE_25FPS;

static u8 cur_sensor_type = 0xff;

static u8 vrefh_min_tlb = 0x0c;
static u8 pre_index = 0;


extern void *bg0806_mipi_get_ae_params();
extern void *bg0806_mipi_get_awb_params();
extern void *bg0806_mipi_get_iq_params();
extern void bg0806_mipi_ae_ev_init(u32 fps);

typedef struct {
    u16 addr;
    u8 value;
} Sensor_reg_ini;

struct stVrefh {
    u16 index;
    u16 th_low;
    u16 th_high;
    u8 vrefh;
};

struct stVrefh stVrefhTable[] = {
    {5, 263, 267, 0x22},
    {4, 216, 220, 0x1c},
    {3, 176, 180, 0x17},
    {2, 130, 134, 0x12},
    {1, 113, 117, 0x10}
};

//bg0806 sensor 的接口配置，如需对应接口，则定义下面宏定义
//默认定义为mipi模式
//#define BG0806_MIPI
#define BG0806_DVP


//如果系统VDDIO使用3.3V请定义此宏定义值为1
//如果系统VDDIO使用1.8V请定义此宏定义值为0
#define	VDDIO_VOLTAGE_3V3 	1


#define DSC_ADDR_BASE 0x0400

static Sensor_reg_ini BG0806_MIPI_INI_REG[] = {
    0x0200, 0x0001,
    0x0003, 0x0027,

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	0x004f, 0x000c,
#if VDDIO_VOLTAGE_3V3
    0x005c, 0x07, //lsh_io ctrlbit for 3.3VDDIO
#else
    0x005c, 0x00, //lsh_io ctrlbit for 1.8VDDIO
#endif
    0x0061, 0x0002,
    0x0062, 0x005c,//rmp2_w@pclk domain
    0x0064, 0x0000,
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    0x008e, 0x0000,
	//0x008d, 0x003f,// 1218
    0x008f, 0x0000,
    0x0090, 0x0001,
    0x0094, 0x0001,//rmp div1
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    0x01a5, 0x0007,//row noise on 07
	//0x0132, 0x0001,//k
    0x0160, 0x0000,
    0x0161, 0x0030,
    0x0162, 0x0000,
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    0x0206, 0x0000,
	//0x006e, 0x0000,//20180110

    0x0207, 0x0000,
    0x0053, 0x0000,
    0x0054, 0x0028,//plm_cnt
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    0x008d, 0x003f,//
#ifndef	BG0806_DVP
    0x008e, 0x000c,//oen_ctrl,0c
    0x008f, 0x0003,//io_sel_ctrl,03
    0x00fa, 0x00cf,//ispc,c7
#else
	0x008e, 0x0000,//oen_ctrl,0c
	0x008f, 0x0000,//io_sel_ctrl,03
	0x00fa, 0x008f,//ispc,c7
#endif

    0x0391, 0x0000,//mipi_ctrl1,(raw10)
    0x0392, 0x0000,//mipi_ctrl2,default
    0x0393, 0x0001,//mipi_ctrl3,default
    0x0398, 0x000a,//28(25M),14(50M),0a(100M),08(111.375)

#ifndef	BG0806_DVP
	0x0390, 0x0006,//mipi_ctrl0,bit[1],mipi enable
#else
	0x0390, 0x0000,//mipi_ctrl0,bit[1],mipi enable
#endif

    #if BG0806_H_V_MIRROR
    0x0020, 0x000f,
    0x0003, 0x0028,
    0x0005, 0x0001,
    #endif
	#if 0
	0x0020, 0x0000,
    0x0003, 0x0027,
    0x0005, 0x0000,
	#endif
    0x001d, 0x0001

};



const u8 Tab_sensor_dsc[768] = {
    //20170206 update dsc	external ldo
    0x0a, 0x5c, 0x09, 0x4a, 0x08, 0x07, 0x06, 0xee, 0x06, 0x23, 0x05, 0x7e, 0x05, 0x21, 0x05, 0x01, 0x05, 0xcc, 0x06, 0xf5,
    0x08, 0x0b, 0x09, 0x0e, 0x0a, 0x0e, 0x0b, 0x34, 0x0c, 0x42, 0x0e, 0x9b, 0x09, 0xe0, 0x08, 0x71, 0x06, 0xce, 0x05, 0xd7,
    0x05, 0x19, 0x04, 0x9c, 0x04, 0x54, 0x04, 0x4d, 0x04, 0xd2, 0x05, 0xf8, 0x07, 0x04, 0x07, 0xe3, 0x08, 0xe2, 0x09, 0xfe,
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    0x05, 0xc7, 0x06, 0x72, 0x07, 0x84, 0x0a, 0x0d

};


static void *iic = NULL;

unsigned char wrBG0806_MIPIReg(unsigned short regID, unsigned char regDat)
{
    u8 ret = 1;
    u8 high, low;

    high = regID >> 8;
    low = regID & 0xff;

    dev_ioctl(iic, IIC_IOCTL_START, 0);
    if (dev_ioctl(iic, IIC_IOCTL_TX_WITH_START_BIT, 0x64)) {
        ret = 0;
        goto __wend;
    }
    if (dev_ioctl(iic, IIC_IOCTL_TX, high)) {
        ret = 0;
        goto __wend;
    }

    if (dev_ioctl(iic, IIC_IOCTL_TX, low)) {
        ret = 0;
        goto __wend;
    }
    if (dev_ioctl(iic, IIC_IOCTL_TX_WITH_STOP_BIT, regDat)) {
        ret = 0;
        goto __wend;
    }

__wend:

    dev_ioctl(iic, IIC_IOCTL_STOP, 0);
    return ret;
}

unsigned char rdBG0806_MIPIReg(unsigned short regID, unsigned char *regDat)
{
    u8 ret = 1;
    u8 high, low;

    high = regID >> 8;
    low = regID & 0xff;

    dev_ioctl(iic, IIC_IOCTL_START, 0);
    if (dev_ioctl(iic, IIC_IOCTL_TX_WITH_START_BIT, 0x64)) {
        ret = 0;
        goto __rend;
    }

    delay(10);

    if (dev_ioctl(iic, IIC_IOCTL_TX, high)) {
        ret = 0;
        goto __rend;
    }

    delay(10);

    if (dev_ioctl(iic, IIC_IOCTL_TX_WITH_STOP_BIT, low)) {
        ret = 0;
        goto __rend;
    }

    delay(10);

    if (dev_ioctl(iic, IIC_IOCTL_TX_WITH_START_BIT, 0x65)) {
        ret = 0;
        goto __rend;
    }

    delay(10);

    if (dev_ioctl(iic, IIC_IOCTL_RX_WITH_STOP_BIT, (u32)regDat)) {
        ret = 0;
        goto __rend;
    }
__rend:

    dev_ioctl(iic, IIC_IOCTL_STOP, 0);
    return ret;

}


/*************************************************************************************************
 sensor api
 *************************************************************************************************/
void BG0806_MIPI_config_SENSOR(u16 *width, u16 *height, u8 *format, u8 *frame_freq)
{
    u32 i;
    u16 dsc_addr;
    u8 pid;

    rdBG0806_MIPIReg(0x0045, &pid);
    pid = pid & 0x3f;

    printf("bg0806 pid = %x\n", pid);
    for (i = 0; i < sizeof(BG0806_MIPI_INI_REG) / sizeof(Sensor_reg_ini); i++) {
        wrBG0806_MIPIReg(BG0806_MIPI_INI_REG[i].addr, BG0806_MIPI_INI_REG[i].value);
    }

    switch (pid) {
    case BG0806A:
        wrBG0806_MIPIReg(0x0206, 0x02);
        wrBG0806_MIPIReg(0x0207, 0xc8);
        wrBG0806_MIPIReg(0x0132, 0x01);
        wrBG0806_MIPIReg(0x0133, 0x38);
        break;
    case BG0806C1:
    case BG0806C2:
        wrBG0806_MIPIReg(0x0206, 0x02);
        wrBG0806_MIPIReg(0x0207, 0xaa);
        wrBG0806_MIPIReg(0x0132, 0x01);
        wrBG0806_MIPIReg(0x0133, 0x56);
        break;
    case BG0806B1:
    case BG0806B2:
    default:
        wrBG0806_MIPIReg(0x0206, 0x02);
        wrBG0806_MIPIReg(0x0207, 0xde);
        wrBG0806_MIPIReg(0x0132, 0x01);
        wrBG0806_MIPIReg(0x0133, 0x22);
        break;
    }

    dsc_addr = DSC_ADDR_BASE;

    for (i = 0; i < 768; i++) {
        wrBG0806_MIPIReg(dsc_addr + i, Tab_sensor_dsc[i]);
    }

    wrBG0806_MIPIReg(0x001d, 0x01);

    *format = SEN_IN_FORMAT_GRBG;

    bg0806_mipi_ae_ev_init(*frame_freq);

    wrBG0806_MIPIReg(0x001d, 0x02);

    return;
}

s32 BG0806_MIPI_set_output_size(u16 *width, u16 *height, u8 *frame_freq)
{
    return 0;
}

s32 BG0806_MIPI_power_ctl(u8 isp_dev, u8 is_work)
{
    return 0;
}

void BG0806_MIPI_xclk_set(u8 isp_dev)
{

}

s32 BG0806_MIPI_ID_check(void)
{
    u8 pid = 0x00;
    u8 ver = 0x00;
    u8 i;

    for (i = 0; i < 3; i++) {
        rdBG0806_MIPIReg(0x0000, &pid);
        rdBG0806_MIPIReg(0x0001, &ver);
    }

    puts("Sensor ID \n");
    put_u8hex(pid);
    put_u8hex(ver);
    puts("\n");

    if (pid != 0x08 || ver != 0x06) {
        puts("\n----not BG0806_dvp-----\n");
        return -1;
    }
    puts("\n----hello BG0806_dvp-----\n");
    return 0;
}

void BG0806_MIPI_reset(u8 isp_dev)
{
    puts("BG0806_dvp reset \n");

    u32 reset_gpio;
    u32 pwdn_gpio;

    if (isp_dev == ISP_DEV_0) {
        reset_gpio = reset_gpios[0];
        pwdn_gpio = pwdn_gpios[0];
    } else {
        reset_gpio = reset_gpios[1];
        pwdn_gpio = pwdn_gpios[1];
    }

    printf("gpio=%d\n", reset_gpio);
    gpio_direction_output(pwdn_gpio, 0);
    gpio_direction_output(reset_gpio, 0);
    delay(40000);
    gpio_direction_output(reset_gpio, 1);
    delay(40000);

}

s32 BG0806_MIPI_check(u8 isp_dev, u32 reset_gpio, u32 pwdn_gpio)
{
    printf("\n\n BG0806_MIPI_check reset pin :%d\n\n", reset_gpio);
    if (!iic) {
        if (isp_dev == ISP_DEV_0) {
            iic = dev_open("iic0", 0);
        } else {
            iic = dev_open("iic1", 0);
        }
        if (!iic) {
            return -1;
        }
    } else {
        if (cur_sensor_type != isp_dev) {
            return -1;
        }
    }
    printf("\n\n isp_dev =%d\n\n", isp_dev);

    reset_gpios[isp_dev] = reset_gpio;
    pwdn_gpios[isp_dev] = pwdn_gpio;

    BG0806_MIPI_reset(isp_dev);

    if (0 != BG0806_MIPI_ID_check()) {
        dev_close(iic);
        iic = NULL;
        return -1;
    }

    cur_sensor_type = isp_dev;


    return 0;
}


s32 BG0806_MIPI_init(u8 isp_dev, u16 *width, u16 *height, u8 *format, u8 *frame_freq)
{
    //puts("\n\n BG0806_MIPI_init \n\n");

    BG0806_MIPI_config_SENSOR(width, height, format, frame_freq);
    return 0;
}



static void set_again(u32 again)
{
    wrBG0806_MIPIReg(0x00b1, again);
    return;
}

static void set_dgain(u32 dgain)
{

    wrBG0806_MIPIReg(0x00bc, dgain >> 8);
    wrBG0806_MIPIReg(0x00bd, dgain & 0xff);
}
static void cal_texp_mck(u32 exp_time, u32 *texp, u32 *mck)
{

    u32 tmp2 = 0;
    s32 remain_ns = 0;

#if BG0806_VARIABLE_FPS
    if (exp_time > 50000) {
        gVblank = VBLANK_16FPS;
        gExplineMax = MAX_EXP_LINE_16FPS;
    } else if (exp_time > 40000) {
        gVblank = VBLANK_20FPS;
        gExplineMax = MAX_EXP_LINE_20FPS;
    } else if (exp_time > 30000) {
        gVblank = VBLANK_25FPS;
        gExplineMax = MAX_EXP_LINE_25FPS;
    } else {
        gVblank = VBLANK_30FPS;
        gExplineMax = MAX_EXP_LINE_30FPS;
    }
#endif

    *texp = exp_time * 1000 / ROW_TIME_NS;

    if (*texp >= gExplineMax) {
        *texp = gExplineMax;
    } else if (*texp < 1) {
        *texp = 1;
    }

    tmp2 = (*texp) * ROW_TIME_NS;
    remain_ns = exp_time * 1000 - tmp2;
    if (remain_ns > 0) {
        if (remain_ns >= ROW_TIME_NS) {
            *mck = gRowTime;
        } else {
            *mck = (remain_ns * gRowTime / ROW_TIME_NS);
        }
    } else {
        *mck = 0;
    }

    return;
}

static void calc_gain(u32 gain, u8 *_again, u16 *_dgain)
{

    u32 total_gain;
    u8 vrefh, temp;
    u16 dgain;

    u32 dark_ave;

    u16 vrefh_old;
    u16 rmp_gain;
    u8 i, rdRegDat;

#if 0

    rdBG0806_MIPIReg(0x00b1, &rdRegDat) ;
    vrefh_old = rdRegDat ;
    rmp_gain = 128 / (vrefh_old + 1);

    dark_ave = 0 ;
    rdBG0806_MIPIReg(0x012b, &rdRegDat) ;
    dark_ave = rdRegDat ;
    dark_ave <<= 8 ;
    rdBG0806_MIPIReg(0x012c, &rdRegDat) ;
    dark_ave |= rdRegDat ;

    if (dark_ave > 0xfff) {
        dark_ave = 0;
    }

    dark_ave = dark_ave / rmp_gain;

    if (dark_ave < stVrefhTable[4].th_low) {
        pre_index = 0;
        vrefh_min_tlb = 0x0c;
    } else {
        i = 0;
        while (i < 5) {
            if (pre_index < stVrefhTable[i].index && dark_ave > stVrefhTable[i].th_high) {
                pre_index = stVrefhTable[i].index;
                vrefh_min_tlb = stVrefhTable[i].vrefh;
                break;
            }
            i++;
        }

        i = 0;
        for (i = 0;i < 5;i++ ) {
            if (pre_index >=  stVrefhTable[i].index && dark_ave < stVrefhTable[i].th_low) {
                pre_index = stVrefhTable[i - 1].index;
                vrefh_min_tlb = stVrefhTable[i - 1].vrefh;
            }
        }
    }
#endif

    total_gain = gain >> 4;
    if (total_gain >= (128 << 6)) {
        vrefh = 0;
    } else {
        vrefh = (128 << 6) / total_gain - 1;
    }

    if (vrefh > 0x7f) {
        vrefh = 0x7f ;
    } else if (vrefh < vrefh_min_tlb) {
        vrefh = vrefh_min_tlb ;
    }

    dgain = (total_gain * (vrefh + 1) * (1 << 3)) / 128; //dgain



    *_again = vrefh ;
    *_dgain = dgain ;

    //printf("_again=%d, _dgain=%d\n", *_again, *_dgain);
}

static void set_shutter(u32 texp, u32 texp_mck)
{
    wrBG0806_MIPIReg(0x0021, gVblank >> 8);
    wrBG0806_MIPIReg(0x0022, gVblank & 0xff);
    wrBG0806_MIPIReg(0x000c, texp >> 8);
    wrBG0806_MIPIReg(0x000d, texp & 0xff); //
}


u32 bg0806_mipi_calc_shutter(isp_ae_shutter_t *shutter, u32 exp_time_us, u32 gain)
{
    u32 texp;
    u32 mck;

    cal_texp_mck(exp_time_us, &texp, &mck);

    //printf(" \n exp_time_us %d\n", exp_time_us); // ppk added on 20170609

    shutter->ae_exp_line =  texp;
    shutter->ae_gain = gain;
    shutter->ae_exp_clk = mck;


    return 0;

}



u32 bg0806_mipi_set_shutter(isp_ae_shutter_t *shutter)
{
    u32 again, dgain;
    calc_gain(shutter->ae_gain, &again, &dgain);



    set_again(again);
    set_dgain(dgain);

    set_shutter(shutter->ae_exp_line, shutter->ae_exp_clk);

    wrBG0806_MIPIReg(0x001d, 0x02);

    return 0;
}


u32 bg0808_dvp_mirr(u8 on)
{
	if(on)
	{
		BG0806_MIPI_W_Reg(0x0020, 0x000f);
		BG0806_MIPI_W_Reg(0x0003, 0x0028);
		BG0806_MIPI_W_Reg(0x0005, 0x0001);
	}
	else
	{
		BG0806_MIPI_W_Reg(0x0020, 0x0000);
		BG0806_MIPI_W_Reg(0x0003, 0x0027);
		BG0806_MIPI_W_Reg(0x0005, 0x0000);	
	}
	BG0806_MIPI_W_Reg(0x001d, 0x0002);
	return 0;
}

void BG0806_MIPI_sleep()
{

}

void BG0806_MIPI_wakeup()
{

}

void BG0806_MIPI_W_Reg(u16 addr, u16 val)
{
    wrBG0806_MIPIReg((u16) addr, (u8) val);
}

u16 BG0806_MIPI_R_Reg(u16 addr)
{
    u8 val;
    rdBG0806_MIPIReg((u16) addr, &val);
    return val;
}



REGISTER_CAMERA(BG0806_MIPI_M) = {
    .logo 				= 	"BG0806M",
    .isp_dev 			= 	ISP_DEV_NONE,
    //#if BG0806_H_V_MIRROR
    //.in_format 			= 	SEN_IN_FORMAT_GBRG,
    //#else
    //.in_format 			= 	SEN_IN_FORMAT_GRBG,
    //#endif
	.in_format 			= 	SEN_IN_FORMAT_GRBG,
    .out_format 		= 	ISP_OUT_FORMAT_YUV,

    #ifdef BG0806_DVP
    .mbus_type          =   SEN_MBUS_PARALLEL,
    .mbus_config        =   SEN_MBUS_DATA_WIDTH_10B | SEN_MBUS_PCLK_SAMPLE_FALLING,
    #else
    .mbus_type          =   SEN_MBUS_CSI2,
    .mbus_config        =   SEN_MBUS_DATA_WIDTH_10B | SEN_MBUS_CSI2_1_LANE,
    #endif
    .fps         		= 	30, // 30,

    .sen_size 			= 	{BG0806_MIPI_OUTPUT_W, BG0806_MIPI_OUTPUT_H},
    .isp_size 			= 	{BG0806_MIPI_OUTPUT_W, BG0806_MIPI_OUTPUT_H},

    .cap_fps         		= 	30,
    .sen_cap_size 			= 	{BG0806_MIPI_OUTPUT_W, BG0806_MIPI_OUTPUT_H},
    .isp_cap_size 			= 	{BG0806_MIPI_OUTPUT_W, BG0806_MIPI_OUTPUT_H},

    .ops                =   {
        .avin_fps           =   NULL,
        .avin_valid_signal  =   NULL,
        .avin_mode_det      =   NULL,
        .sensor_check 		= 	BG0806_MIPI_check,
        .init 		        = 	BG0806_MIPI_init,
        .set_size_fps 		=	BG0806_MIPI_set_output_size,
        .power_ctrl         =   BG0806_MIPI_power_ctl,

        .get_ae_params 	    =	bg0806_mipi_get_ae_params,
        .get_awb_params 	=	bg0806_mipi_get_awb_params,
        .get_iq_params 	    =	bg0806_mipi_get_iq_params,

        .sleep 		        =	BG0806_MIPI_sleep,
        .wakeup 		    =	BG0806_MIPI_wakeup,
        .write_reg 		    =	BG0806_MIPI_W_Reg,
        .read_reg 		    =	BG0806_MIPI_R_Reg,

    }
};


#endif

