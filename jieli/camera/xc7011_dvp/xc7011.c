#include "asm/iic.h"
#include "asm/isp_dev.h"
#include "gpio.h"
#include "xc7011.h"

static u32 reset_gpio[2] = {-1, -1};
static u32 pwdn_gpios[2] = {-1, -1};
static void *iic = NULL;
typedef struct {
    u16 addr;
    u8 value;
} Sensor_reg_ini;

typedef struct {
    u8 addr;
    u8 value;
} Sensor_reg_inix;

#define  XC7011_WRCMD  0x36
#define  XC7011_RDCMD  0x37
#define  H42_WRCMD  0x60
#define  H42_RDCMD  0x61

unsigned char wrXC7011Reg(unsigned short regID, unsigned char regDat)
{
    u8 ret = 1;
    u8 high, low;

    high = regID >> 8;
    low = regID & 0xff;

    dev_ioctl(iic, IIC_IOCTL_START, 0);
    if (dev_ioctl(iic, IIC_IOCTL_TX_WITH_START_BIT,	XC7011_WRCMD)) {
        ret = 0;
        puts("wr err 0\n");
        goto __wend;
    }
    if (dev_ioctl(iic, IIC_IOCTL_TX, high)) {
        ret = 0;
        puts("wr err 1\n");
        goto __wend;
    }

    if (dev_ioctl(iic, IIC_IOCTL_TX, low)) {
        ret = 0;
        puts("wr err 2\n");
        goto __wend;
    }
    if (dev_ioctl(iic, IIC_IOCTL_TX_WITH_STOP_BIT, regDat)) {
        ret = 0;
        puts("wr err 3\n");
        goto __wend;
    }

__wend:

    dev_ioctl(iic, IIC_IOCTL_STOP, 0);
    return ret;
}

unsigned char rdXC7011Reg(unsigned short regID, unsigned char *regDat)
{
    u8 ret = 1;
    u8 high, low;

    high = regID >> 8;
    low = regID & 0xff;
    dev_ioctl(iic, IIC_IOCTL_START, 0);
    if (dev_ioctl(iic, IIC_IOCTL_TX_WITH_START_BIT, XC7011_WRCMD)) {
        ret = 0;
        puts("rd err 0\n");
        goto __rend;
    }

    delay(10);

    if (dev_ioctl(iic, IIC_IOCTL_TX, high)) {
        puts("rd err 1\n");
        ret = 0;
        goto __rend;
    }

    delay(10);

    if (dev_ioctl(iic, IIC_IOCTL_TX, low)) {
        ret = 0;
        puts("rd err 2\n");
        goto __rend;
    }

    delay(10);

    if (dev_ioctl(iic, IIC_IOCTL_TX_WITH_START_BIT, XC7011_RDCMD)) {
        ret = 0;
        puts("rd err 3\n");
        goto __rend;
    }

    delay(10);

    if (dev_ioctl(iic, IIC_IOCTL_RX_WITH_STOP_BIT, (u32)regDat)) {
        ret = 0;
        puts("rd err 4\n");
        goto __rend;
    }
__rend:

    dev_ioctl(iic, IIC_IOCTL_STOP, 0);
    return ret;

}


static unsigned char wrH42Reg(unsigned char regID, unsigned char regDat)
{
    u8 ret = 1;

    dev_ioctl(iic, IIC_IOCTL_START, 0);

    if (dev_ioctl(iic, IIC_IOCTL_TX_WITH_START_BIT, H42_WRCMD)) {
        ret = 0;
        goto __wend;
    }

    delay(10);

    if (dev_ioctl(iic, IIC_IOCTL_TX, regID)) {
        ret = 0;
        goto __wend;
    }

    delay(10);

    if (dev_ioctl(iic, IIC_IOCTL_TX_WITH_STOP_BIT, regDat)) {
        ret = 0;
        goto __wend;
    }
__wend:

    dev_ioctl(iic, IIC_IOCTL_STOP, 0);
    return ret;
}

static unsigned char rdH42Reg(unsigned char regID, unsigned char *regDat)
{
    u8 ret = 1;
    dev_ioctl(iic, IIC_IOCTL_START, 0);
    if (dev_ioctl(iic, IIC_IOCTL_TX_WITH_START_BIT, H42_WRCMD)) {
        ret = 0;
        goto __rend;
    }

    delay(100);

    if (dev_ioctl(iic, IIC_IOCTL_TX_WITH_STOP_BIT, regID)) {
        ret = 0;
        goto __rend;
    }

    delay(100);

    if (dev_ioctl(iic, IIC_IOCTL_TX_WITH_START_BIT, H42_RDCMD)) {
        ret = 0;
        goto __rend;
    }

    delay(100);

    dev_ioctl(iic, IIC_IOCTL_RX_WITH_STOP_BIT, (u32)regDat);

__rend:

    dev_ioctl(iic, IIC_IOCTL_STOP, 0);

    return ret;

}



Sensor_reg_ini XC7011_default_regs[] = {



    0xfffd, 0x80,
    0xfffe, 0x50,
    0x001c, 0xff,
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    0x0090, 0x29,
    /* 0x0090,0x2b, *///color bar

    0xfffe, 0x20,
    0x0000, 0x20,
    0x0004, 0x5,
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    0x012d, 0x30,

    ///////////////////////////////////////
    /////   patch   start   ///////////////
    ///////////////////////////////////////
    0xfffd, 0x80,
    0xfffe, 0x50,
    0x000e, 0x54,
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    0x693, 0xc,

    //patch configure   /////////////////
    0x06e, 0x30,  //magnitude offset
    0x06f, 0x20,  //magnitude Min
    0x070, 0xc0,  //magnitude MAX
    //////ENABLE////////////////////////////
    0xfffe, 0x30,
    0x0051, 0x03,

    0xfffe, 0x50,
    0x0137, 0x99,
    0xfffe, 0x14,

    ///////////////////////////////////////
    /////   patch   end     ///////////////
    ///////////////////////////////////////
    /* ND */


    0xfffe, 0x30, //lenc_200_80%
    0x0200, 0x0,
    0x0201, 0x0,
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    0x1704, 0x23,


};


Sensor_reg_ini bypass_on[] = {
    0xfffd, 0x80,
    0xfffe, 0x50,
    0x004d, 0x01,
};

Sensor_reg_ini bypass_off[] = {
    0xfffd, 0x80,
    0xfffe, 0x50,
    0x004d, 0x00,
};




Sensor_reg_inix H42_regs[] = {

    // H42_1280x720_SET


    0x12, 0x40,
    0x0D, 0x40,
    0x1F, 0x04,
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    0x12, 0x30, //PWDN Setting


};


void xc7011_reset(u8 isp_dev)
{
    u32 gpio;
    u32 pwdn_gpio;
    if (isp_dev == ISP_DEV_0) {
        gpio = reset_gpio[0];
        pwdn_gpio = pwdn_gpios[0];
    } else {
        gpio = reset_gpio[1];
        pwdn_gpio = pwdn_gpios[1];
    }


    gpio_direction_output(pwdn_gpio, 0);
    gpio_direction_output(gpio, 1);
    delay(50000);
    gpio_direction_output(gpio, 0);
    delay(50000);
    gpio_direction_output(gpio, 1);
}
s32 _xc7011_id_check(void)
{
    u8 id_hi;
    u8 id_lo;
    u32 i ;

    for (i = 0; i < 5; i++) { //

        rdXC7011Reg(0xfffb, &id_hi);
        rdXC7011Reg(0xfffc, &id_lo);

        if (id_hi == 0x70 && id_lo == 0x11) {
            puts("Sensor PID \n");
            put_u8hex(id_hi);
            put_u8hex(id_lo);
            puts("\n----hello XC7011-----\n");
            return 0;
        }
    }
    puts("\n----not XC7011-----\n");
    return -1;
}


static u8 cur_sensor_type = 0xff;
s32 xc7011_id_check(u8 isp_dev, u32 _reset_gpio, u32 pwdn_gpio)
{
    if (!iic) {
        if (isp_dev == ISP_DEV_0) {
            iic = dev_open("iic0", 0);
        } else {
            iic = dev_open("iic2", 0);
        }
        if (!iic) {
            return -1;
        }
    } else {
        if (cur_sensor_type != isp_dev) {
            return -1;
        }
    }

    reset_gpio[isp_dev] = _reset_gpio;
    pwdn_gpios[isp_dev] = pwdn_gpio;
    xc7011_reset(isp_dev);

    if (0 != _xc7011_id_check()) {
        dev_close(iic);
        iic = NULL;
        return -1;
    }

    cur_sensor_type = isp_dev;

    return 0;

}
void XC7011_config_SENSOR(u16 *width, u16 *height, u8 *format, u8 *frame_freq)
{
    u32 i;
    u32 frame_exp_rows;
    u8 tmp;
    for (i = 0; i < sizeof(XC7011_default_regs) / sizeof(Sensor_reg_ini); i++) {
        wrXC7011Reg(XC7011_default_regs[i].addr, XC7011_default_regs[i].value);
    }

    for (i = 0; i < sizeof(bypass_on) / sizeof(Sensor_reg_ini); i++) {
        wrXC7011Reg(bypass_on[i].addr, bypass_on[i].value);
    }

    for (i = 0; i < sizeof(H42_regs) / sizeof(Sensor_reg_inix); i++) {
        wrH42Reg(H42_regs[i].addr, H42_regs[i].value);
    }

    for (i = 0; i < sizeof(bypass_off) / sizeof(Sensor_reg_ini); i++) {
        wrXC7011Reg(bypass_off[i].addr, bypass_off[i].value);
    }


    return;
}



s32 XC7011_init(u8 isp_dev, u16 *width, u16 *height, u8 *format, u8 *frame_freq)
{
    puts("\n\n xc7011_init and h42init \n\n");

    XC7011_config_SENSOR(width, height, format, frame_freq);

    return 0;
}

s32 xc7011_set_output_size(u16 *width, u16 *height, u8 *freq)
{

    return 0;
}


s32 xc7011_power_ctl(u8 isp_dev, u8 is_work)
{
    return 0;
}
u8 xc7011_fps()
{
    return 0;//30fps
}
u8 xc7011_valid_signal(void)
{
    return 1;//valid
}

static u8 xc7011_mode_det(void)
{
    return 0;
}

REGISTER_CAMERA(XC7011) = {
    .logo 				= 	"XC7011",
    .isp_dev 			= 	ISP_DEV_NONE,
    .in_format 			= 	SEN_IN_FORMAT_YUYV,
    .out_format 		= 	ISP_OUT_FORMAT_YUV,
    .mbus_type          =   SEN_MBUS_PARALLEL,
    .mbus_config        =   SEN_MBUS_DATA_WIDTH_8B | SEN_MBUS_HSYNC_ACTIVE_HIGH | SEN_MBUS_PCLK_SAMPLE_FALLING,
    .fps         		= 	30,

    .sen_size 			= 	{1280, 720},
    .isp_size 			= 	{1280, 720},

    .ops                    = {
        .avin_fps           =   xc7011_fps,
        .avin_valid_signal  =   xc7011_valid_signal,
        .avin_mode_det      =   xc7011_mode_det,
        .sensor_check 		= 	xc7011_id_check,
        .init 		        = 	XC7011_init,
        .set_size_fps 		=	xc7011_set_output_size,
        .power_ctrl         =   xc7011_power_ctl,


        .sleep 		        =	NULL,
        .wakeup 		    =	NULL,
        .write_reg 		    =	NULL,
        .read_reg 		    =	NULL,
    }
};







